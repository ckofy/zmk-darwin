## config/boards/shields/darwin/Kconfig.shield
```kconfig
# Copyright (c) 2020 Pete Johanson
# SPDX-License-Identifier: MIT

config SHIELD_darwin_LEFT
    def_bool $(shields_list_contains,darwin_left)

config SHIELD_darwin_RIGHT
    def_bool $(shields_list_contains,darwin_right)
```
